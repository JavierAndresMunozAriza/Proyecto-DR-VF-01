## CMakeLists.txt
```
cmake_minimum_required(VERSION 3.20.0)

find_package(Zephyr REQUIRED HINTS $ENV{ZEPHYR_BASE})
project(dr_vf_01)

target_include_directories(app PRIVATE include)

target_sources(app PRIVATE
	src/main.c
	src/alert/alert_color.c
	src/app/app.c
	src/app/app_demo.c
	src/app/app_fix.c
	src/app/app_fsm.c
	src/app/app_led.c
	src/app/app_sync.c
	src/button/button.c
	src/demo/demo_route.c
	src/fence/fence_square.c
	src/fence_codec/fence_codec.c
	src/fence_manager/fence_manager.c
	src/geofence/geofence.c
	src/gnss/gnss_nrf91.c
	src/led/rgb_led.c
	src/telemetry/telemetry.c
	src/timing/timing.c
)

target_sources_ifdef(CONFIG_DRVF_FENCE_STORAGE app PRIVATE
	src/storage/fence_store_settings.c
)

target_sources_ifdef(CONFIG_DRVF_GEOFENCE_BENCHMARK app PRIVATE
	src/bench/bench_polygon.c
	src/bench/geofence_bench.c
)

target_sources_ifdef(CONFIG_DRVF_CLOUD app PRIVATE
	src/cloud/cloud_nrfcloud.c
	src/cloud/cloud_sync.c
)
```

## Kconfig
```
mainmenu "DR-VF-01 firmware"

config DRVF_GEOFENCE_BENCHMARK
	bool "Run the geofence timing benchmark at boot"
	help
	  Times geofence_check() on regular polygons of 4 to 1024 vertices before
	  the application starts and logs the mean time per call. For
	  measurement builds only: it delays the start by a few seconds.

config DRVF_GNSS_COLD_START
	bool "Delete the stored GNSS data at every boot (cold start)"
	help
	  The modem keeps satellite data between boots, so a reboot is a hot
	  start. This option deletes that data before starting the GNSS, to
	  measure the time to first fix of a real cold start. Debug feature: do
	  not use it in a product.

config DRVF_FENCE_AUTO_SQUARE
	bool "Make a square fence around the first fix when there is no other fence"
	default y
	help
	  With no stored or downloaded fence, the first accurate GNSS fix defines
	  a 60 m square fence around it, as in the first proof of concept. Turn it
	  off in a product, which should wait for the fence the user drew.

config DRVF_FENCE_STORAGE
	bool "Keep the fence in flash, so it survives a reboot"
	depends on SETTINGS
	help
	  Stores each fence received from outside in the settings subsystem and
	  loads it at boot. Needs CONFIG_SETTINGS with a flash backend.

config DRVF_TELEMETRY_HEARTBEAT_S
	int "Seconds between telemetry reports when nothing changes"
	default 900
	help
	  A report is also sent when the state, inside or outside, or the fence
	  version changes. Each cloud message counts against the plan quota.

config DRVF_TELEMETRY_MIN_INTERVAL_S
	int "Minimum seconds between two telemetry reports"
	default 30
	help
	  Keeps a collar walking along the fence line from flooding the link: a
	  change that comes sooner waits for this interval.

config DRVF_CLOUD
	bool "Sync the fence and telemetry with the cloud over LTE"
	help
	  Brings up LTE-M/NB-IoT (with PSM and eDRX), connects to nRF Cloud over
	  CoAP, downloads the fence the user drew and uploads telemetry. Needs
	  the extra options of overlay-cloud.conf: build it with
	  `./build.sh cloud`.

if DRVF_CLOUD

config DRVF_CLOUD_POLL_INTERVAL_S
	int "Seconds between two checks for a new fence"
	default 120
	help
	  The cloud cannot push a fence to a device in PSM: the device asks. A
	  short interval makes field tests quick; a product would use a longer
	  one to save energy and data.

config DRVF_CLOUD_THREAD_STACK_SIZE
	int "Stack size of the cloud worker thread (bytes)"
	default 6144

config DRVF_CLOUD_SHADOW_BUF_SIZE
	int "Size of the device shadow response buffer (bytes)"
	default 2048
	help
	  Holds the shadow delta as JSON. It must hold the base64 text of the
	  largest fence blob plus the rest of the delta.

config DRVF_CLOUD_MSG_BUF_SIZE
	int "Size of the telemetry message buffer (bytes)"
	default 512
	help
	  Holds the telemetry JSON plus the nRF Cloud message envelope.

config DRVF_CLOUD_REGISTER_TIMEOUT_S
	int "Seconds to wait for the network registration"
	default 300

config DRVF_CLOUD_DATE_TIME_TIMEOUT_S
	int "Seconds to wait for a valid date and time"
	default 60
	help
	  nRF Cloud authentication signs a token with the current time.

config DRVF_CLOUD_PROVISION_TIMEOUT_S
	int "Seconds to wait for the provisioning service"
	default 300

endif # DRVF_CLOUD

source "Kconfig.zephyr"
```

## prj.conf
```kconfig
CONFIG_LOG=y
CONFIG_PWM=y
CONFIG_GPIO=y
CONFIG_FPU=y
CONFIG_CBPRINTF_FP_SUPPORT=y
CONFIG_MAIN_STACK_SIZE=4096

# nRF9151 modem, used in GNSS-only mode (no LTE; the cloud build adds it, see overlay-cloud.conf)
CONFIG_NRF_MODEM_LIB=y
CONFIG_LTE_LINK_CONTROL=y
CONFIG_SYSTEM_WORKQUEUE_STACK_SIZE=1536
```

## overlay-cloud.conf
```kconfig
# Extra options of the cloud build (./build.sh cloud), on top of prj.conf.
# Based on the Nordic Asset Tracker Template (NCS v3.4.1), keeping only what
# the nRF Cloud CoAP adapter needs: no FOTA, no Memfault, no location.

CONFIG_DRVF_CLOUD=y

# Heap: nRF Cloud (cJSON, CBOR), provisioning and the CoAP client allocate
CONFIG_HEAP_MEM_POOL_SIZE=12288
CONFIG_HEAP_MEM_POOL_IGNORE_MIN=y
# Some nRF Cloud credentials are longer than 1024 bytes
CONFIG_AT_MONITOR_HEAP_SIZE=2176

# Log buffer: the attestation token (about 600 characters) is one message
CONFIG_LOG_BUFFER_SIZE=4096

# Networking: sockets offloaded to the modem
CONFIG_NETWORKING=y
CONFIG_NET_SOCKETS=y
CONFIG_NET_IPV4=y

# LTE link: GNSS stays in the system mode so that both can run together
CONFIG_LTE_NETWORK_MODE_LTE_M_NBIOT_GPS=y
CONFIG_LTE_LC_PDN_MODULE=y
CONFIG_LTE_LC_PSM_MODULE=y
CONFIG_LTE_LC_EDRX_MODULE=y
CONFIG_LTE_LC_WORKQUEUE_STACK_SIZE=896
CONFIG_NRF_MODEM_LIB_SHMEM_TX_SIZE=4096
CONFIG_NRF_MODEM_LIB_SHMEM_RX_SIZE=4096

# PSM requested at modem start (same values as the Asset Tracker Template).
# The tracking area update period is longer than the sync interval.
CONFIG_LTE_PSM_REQ=y
CONFIG_LTE_PROPRIETARY_PSM_REQ=y
CONFIG_LTE_PSM_REQ_FORMAT_SECONDS=y
CONFIG_LTE_PSM_REQ_RPTAU_SECONDS=7200
# Short active time: the device polls for downlink data
CONFIG_LTE_PSM_REQ_RAT_SECONDS=6

# eDRX: "0000" is 5.12 s
CONFIG_LTE_EDRX_REQ=y
CONFIG_LTE_EDRX_REQ_VALUE_LTE_M="0000"
CONFIG_LTE_EDRX_REQ_VALUE_NBIOT="0000"

# Modem key management and JWT for the nRF Cloud authentication
CONFIG_MODEM_KEY_MGMT=y
CONFIG_MODEM_JWT=y
CONFIG_MODEM_INFO=y

# nRF Cloud over CoAP
CONFIG_NRF_CLOUD=y
CONFIG_NRF_CLOUD_COAP=y
CONFIG_NRF_CLOUD_CHECK_CREDENTIALS=y
CONFIG_NRF_CLOUD_CREDENTIALS_MGMT_MODEM=y
CONFIG_NRF_CLOUD_COAP_MAX_RETRIES=3
CONFIG_NRF_CLOUD_COAP_DISCONNECT_ON_FAILED_REQUEST=y
CONFIG_NRF_CLOUD_COAP_MAX_USER_OPTIONS=0
CONFIG_NRF_CLOUD_PRINT_DETAILS=n
CONFIG_NRF_CLOUD_SEND_SHADOW_INFO_ON_CONNECT=n

# CoAP client: sized for a shadow delta of about 1.5 KB (a 532-byte fence is
# 712 base64 characters); blocks of 1024 bytes
CONFIG_COAP_MAX_RETRANSMIT=1
CONFIG_COAP_INIT_ACK_TIMEOUT_MS=5000
CONFIG_COAP_CLIENT_THREAD_PRIORITY=14
CONFIG_COAP_CLIENT_BLOCK_SIZE=1024
CONFIG_COAP_CLIENT_MESSAGE_SIZE=1024
CONFIG_COAP_CLIENT_STACK_SIZE=1280
CONFIG_COAP_EXTENDED_OPTIONS_LEN_VALUE=192
CONFIG_COAP_CLIENT_MAX_PATH_LENGTH=128
CONFIG_COAP_CLIENT_MAX_EXTRA_OPTIONS=3

# Date and time from the network (the JWT is signed with it)
CONFIG_DATE_TIME=y
CONFIG_DATE_TIME_LOG_LEVEL_ERR=y

# Shadow delta decoding (zephyr/data/json.h) and base64 of the fence
CONFIG_JSON_LIBRARY=y
CONFIG_BASE64=y

# nRF Provisioning: gets the nRF Cloud credentials. It stores its state with
# the settings subsystem; the NVS backend is chosen so that the fence storage
# can use settings on the same backend.
CONFIG_MODEM_ATTEST_TOKEN=y
CONFIG_NRF_PROVISIONING=y
CONFIG_NRF_PROVISIONING_COAP=y
CONFIG_NRF_PROVISIONING_CODEC=y
CONFIG_NRF_PROVISIONING_CBOR=y
CONFIG_NRF_PROVISIONING_CBOR_RECORDS=5
CONFIG_NRF_PROVISIONING_WITH_CERT=y
CONFIG_NRF_PROVISIONING_RX_BUF_SZ=2560
CONFIG_NRF_PROVISIONING_TX_BUF_SZ=2048
CONFIG_NRF_PROVISIONING_STACK_SIZE=3072
CONFIG_NRF_PROVISIONING_CODEC_AT_CMD_LEN=2048
CONFIG_NRF_PROVISIONING_CODEC_RX_SZ_START=1024
CONFIG_SETTINGS=y
CONFIG_SETTINGS_NVS=y
CONFIG_NVS=y
CONFIG_FLASH=y
CONFIG_FLASH_PAGE_LAYOUT=y
CONFIG_FLASH_MAP=y

# Keep the downloaded fence in flash (settings on NVS, enabled above)
CONFIG_DRVF_FENCE_STORAGE=y

# The cloud build waits for the fence the user drew instead of making a square
# around the first fix (the offline proof of concept keeps that default)
CONFIG_DRVF_FENCE_AUTO_SQUARE=n
```

## src/main.c
```c
/*
 * main.c - firmware entry point
 *
 * Every behavior lives in the modules under src/: the application controller
 * in src/app/, the fence in src/fence_manager/ and src/fence_codec/, the cloud
 * link in src/cloud/, the board adapters in src/gnss/, src/button/ and
 * src/led/. See app.h for how the application is split.
 */

#include "app.h"

int main(void)
{
	return app_run();
}
```

## include/alert_color.h
```c
/**
 * @file alert_color.h
 * @brief Maps the distance to the fence boundary to an RGB alert color
 *
 * Pure C, no hardware dependency, so it is testable on the host. The LED
 * driver (rgb_led) consumes the result; this module never touches a pin.
 *
 * Behavior:
 *  - inside, distance >= safe_m: pure green
 *  - inside, 0 < distance < safe_m: linear mix from green toward red
 *  - inside, distance == 0: pure red, steady
 *  - outside the fence: red, blinking
 *  - invalid input (NaN/infinite/negative distance, safe_m <= 0): red,
 *    blinking (fail safe, same as outside)
 */

#ifndef ALERT_COLOR_H
#define ALERT_COLOR_H

#include <stdbool.h>
#include <stdint.h>

#ifdef __cplusplus
extern "C" {
#endif

typedef struct {
	uint8_t r;
	uint8_t g;
	uint8_t b;
	bool blink;
} alert_color_t;

/**
 * @brief Compute the alert color for one geofence check
 *
 * @param distance_m Distance to the nearest edge in meters (>= 0)
 * @param inside     true if the point is inside the polygon
 * @param safe_m     Distance at or beyond which the color is fully green
 *                   (must be > 0)
 * @return The color to show; never fails, invalid input maps to blinking red
 */
alert_color_t alert_color_from_distance(double distance_m, bool inside,
					double safe_m);

/**
 * @brief Color shown while the application searches for its first fix
 *
 * Blinking blue means no fix has arrived. Blinking cyan means fixes are
 * arriving but their accuracy is too poor to use, which tells "no signal"
 * apart from "weak signal" without a serial console.
 *
 * @param poor_fix_seen  true if a fix with poor accuracy arrived recently
 */
alert_color_t alert_color_searching(bool poor_fix_seen);

/**
 * @brief Color shown when fixes stop arriving after the fence was created
 *
 * Blinking magenta. It is deliberately different from the blinking red of
 * "outside the fence": the gradient from green to red never contains blue,
 * so magenta cannot be mistaken for any position-based alert.
 */
alert_color_t alert_color_fix_lost(void);

#ifdef __cplusplus
}
#endif

#endif /* ALERT_COLOR_H */
```

## include/app.h
```c
/**
 * @file app.h
 * @brief Application entry point: initializes every module and runs the loop
 *
 * The application is split by responsibility under src/app/: app.c (start-up,
 * loop and state machine dispatch), app_fix.c (GNSS fixes and fence checks),
 * app_demo.c (the button demo), app_led.c (alert LED) and app_sync.c (fences
 * from storage and cloud, telemetry). main.c only calls app_run().
 */

#ifndef APP_H
#define APP_H

#ifdef __cplusplus
extern "C" {
#endif

/**
 * @brief Initialize the application and run its loop
 * @return A negative errno if a mandatory module could not start; it does not
 *         return otherwise
 */
int app_run(void);

#ifdef __cplusplus
}
#endif

#endif /* APP_H */
```

## include/app_fsm.h
```c
/**
 * @file app_fsm.h
 * @brief Application state machine: pure transition function
 *
 * Pure C, no hardware dependency, so every transition is testable on the
 * host. The application owns the current state and applies the events.
 *
 * Transitions (any other combination keeps the state):
 *
 *   NO_FENCE   --FENCE_CREATED--> MONITORING  (the first fix made the fence)
 *   NO_FENCE   --FENCE_LOADED---> WAIT_FIX    (a stored fence was loaded)
 *   NO_FENCE   --FENCE_UPDATED--> WAIT_FIX    (a fence arrived from the cloud)
 *   WAIT_FIX   --FIX------------> MONITORING
 *   MONITORING --FIX_TIMEOUT----> FIX_LOST
 *   FIX_LOST   --FIX------------> MONITORING
 *   NO_FENCE, WAIT_FIX, MONITORING, FIX_LOST --GNSS_FAILED--> FAULT
 *   any state except DEMO --DEMO_TOGGLE--> DEMO
 *   DEMO       --DEMO_TOGGLE----> NO_FENCE
 *
 * A new fence replaces the current one in place: FENCE_UPDATED never changes
 * the state once a fence exists. The application releases the demo fence when
 * it leaves the DEMO, so it returns to NO_FENCE and reloads the stored fence,
 * if there is one, by dispatching FENCE_LOADED.
 *
 * DEMO plays a simulated route and ignores every GNSS and fence event, so it
 * works even when the GNSS is unavailable (FAULT) or has no sky view.
 */

#ifndef APP_FSM_H
#define APP_FSM_H

#ifdef __cplusplus
extern "C" {
#endif

enum app_state {
	APP_STATE_NO_FENCE,   /* no fence yet: waiting for one, or for the first fix */
	APP_STATE_WAIT_FIX,   /* fence ready, waiting for the first fix */
	APP_STATE_MONITORING, /* fence ready, fixes arriving */
	APP_STATE_FIX_LOST,   /* fence ready, fixes stopped arriving */
	APP_STATE_FAULT,      /* GNSS not available */
	APP_STATE_DEMO,       /* simulated route, no GNSS needed */
};

enum app_event {
	APP_EVENT_FENCE_CREATED, /* the first accurate fix defined the fence */
	APP_EVENT_FENCE_LOADED,  /* a fence stored in flash was loaded at boot */
	APP_EVENT_FENCE_UPDATED, /* a new fence arrived and was accepted */
	APP_EVENT_FIX,           /* a fix was checked against the fence */
	APP_EVENT_FIX_TIMEOUT,   /* no fix for too long */
	APP_EVENT_GNSS_FAILED,   /* the GNSS could not start or stopped working */
	APP_EVENT_DEMO_TOGGLE,   /* the user asked to enter or leave the demo */
};

/**
 * @brief State reached from @p state when @p event happens
 * @return The next state; @p state itself if the event does not apply
 */
enum app_state app_fsm_next(enum app_state state, enum app_event event);

/**
 * @brief Name of a state, for logs and reports
 * @return The state name, such as "MONITORING"; "UNKNOWN" if @p state is not valid
 */
const char *app_fsm_state_name(enum app_state state);

#ifdef __cplusplus
}
#endif

#endif /* APP_FSM_H */
```

## include/bench_polygon.h
```c
/**
 * @file bench_polygon.h
 * @brief Regular polygons and test points for the geofence timing benchmark
 *
 * Pure C, no hardware dependency. The benchmark times geofence_check() on
 * regular polygons with a growing number of vertices; this module builds
 * them and the points to check, so their geometry can be tested on the host.
 */

#ifndef BENCH_POLYGON_H
#define BENCH_POLYGON_H

#include <stdbool.h>

#include "geofence.h"

#ifdef __cplusplus
extern "C" {
#endif

/** Fewest vertices accepted: with 3 the inner test radius would be an edge midpoint */
#define BENCH_POLYGON_MIN_VERTICES 4

/**
 * @brief Corners of a regular polygon inscribed in a circle
 *
 * Vertex i lies at the bearing 360 * i / n degrees (0 = north) on a circle
 * of radius @p radius_m around @p center.
 *
 * @param center    Center of the circle
 * @param radius_m  Circumradius in meters (> 0)
 * @param n         Number of vertices (>= BENCH_POLYGON_MIN_VERTICES)
 * @param out       Receives @p n vertices
 * @return 0 on success, -1 on a NULL pointer, a non-positive radius or too
 *         few vertices
 */
int bench_polygon_vertices(const geopoint_t *center, double radius_m, unsigned int n,
			   geopoint_t *out);

/**
 * @brief A test point that is surely inside or surely outside the polygon
 *
 * Point @p index of @p count lies at the bearing 360 * index / count degrees,
 * at 0.4 times the radius (inside) or 1.5 times the radius (outside). Both
 * are away from every edge, so the result does not depend on rounding.
 *
 * @return 0 on success, -1 on a NULL pointer, a non-positive radius or
 *         @p count == 0
 */
int bench_polygon_point(const geopoint_t *center, double radius_m, unsigned int index,
			unsigned int count, bool inside, geopoint_t *out);

#ifdef __cplusplus
}
#endif

#endif /* BENCH_POLYGON_H */
```

## include/button.h
```c
/**
 * @file button.h
 * @brief User button adapter
 *
 * Board-independent interface. Each board provides the devicetree alias
 * sw0 in its overlay.
 */

#ifndef BUTTON_H
#define BUTTON_H

#include <stdbool.h>

#ifdef __cplusplus
extern "C" {
#endif

/**
 * @brief Configure the button and its interrupt
 * @return 0 on success, -ENODEV if the GPIO device is not ready, or a
 *         negative errno from the GPIO driver
 */
int button_init(void);

/**
 * @brief Tell whether the button was pressed since the last call
 *
 * Consumes the press: it returns true once per press. Presses closer than
 * the debounce time to the previous accepted press are ignored.
 */
bool button_pressed(void);

#ifdef __cplusplus
}
#endif

#endif /* BUTTON_H */
```

## include/cloud.h
```c
/**
 * @file cloud.h
 * @brief Cloud link port: fence download, fence report, telemetry upload
 *
 * Blocking, POSIX-style calls. They are made from one worker thread only
 * (cloud_sync), so an adapter may keep static buffers and is not reentrant.
 * Adapters: cloud_nrfcloud.c (nRF Cloud over CoAP, through the nRF9151
 * modem). The final board (ESP32-S3 and an external modem) gets its own
 * adapter with these same functions, so the application does not change.
 *
 * Fence exchange, as seen from the cloud: the user's portal writes the fence
 * blob (see fence_codec.h) as one base64 string, `desired.fence`, in the
 * device shadow. The device downloads only what differs from what it last
 * reported, and reports back the same string in `reported.fence`, plus
 * `reported.fence_version` and `reported.fence_status`. Reporting a fence the
 * device refused also echoes it, so a bad fence is not downloaded again.
 */

#ifndef CLOUD_H
#define CLOUD_H

#include <stdbool.h>
#include <stddef.h>
#include <stdint.h>

#ifdef __cplusplus
extern "C" {
#endif

/** Longest operator code (MCC+MNC) in cloud_link_info_t, without the NUL */
#define CLOUD_OPERATOR_MAX 8

/** Radio access technology in use */
enum cloud_rat {
	CLOUD_RAT_UNKNOWN = 0,
	CLOUD_RAT_LTE_M,
	CLOUD_RAT_NB_IOT,
};

/** Radio information for the telemetry report and the field-test log */
typedef struct {
	enum cloud_rat rat;
	bool has_rsrp;
	int16_t rsrp_dbm;                           /**< LTE signal power */
	uint8_t band;                               /**< LTE band, 0 if unknown */
	char operator_id[CLOUD_OPERATOR_MAX + 1];   /**< MCC+MNC, "" if unknown */
} cloud_link_info_t;

/**
 * @brief Bring the link up and connect to the cloud
 *
 * Registers on the cellular network with PSM and eDRX requested, provisions
 * the device if it has no credentials yet and opens the cloud connection.
 * May take minutes on the first connection.
 *
 * @return 0 on success; a negative errno otherwise (-EACCES if the device is
 *         not claimed in the cloud account yet; the adapter logs the
 *         attestation token the user needs)
 */
int cloud_open(void);

/**
 * @brief Close the cloud connection; the cellular registration stays (PSM)
 */
void cloud_close(void);

/**
 * @brief Download the fence the user asked for, if there is a new one
 *
 * @param blob  Receives the fence blob, already decoded from base64
 * @param cap   Capacity of @p blob, FENCE_CODEC_MAX_SIZE is enough
 * @param len   Receives the blob length on success
 * @return 0 if a new fence was written to @p blob; -ENODATA if there is
 *         nothing new; -EBADMSG if the shadow holds a fence value that cannot
 *         be decoded (not valid base64, too large, not a string); the adapter
 *         reports it by itself when it can, so it is not downloaded again, and
 *         it is not a link error; another negative errno on a link error
 */
int cloud_fetch_fence(uint8_t *blob, size_t cap, size_t *len);

/**
 * @brief Report what the device did with a fence it downloaded
 *
 * @param blob     The exact bytes that cloud_fetch_fence() returned
 * @param len      Their length
 * @param version  The fence version, or 0 if the blob could not be decoded
 * @param status   0 if the fence was applied, otherwise the negative
 *                 fence_codec_status or fence_manager status that refused it
 * @return 0 on success; a negative errno otherwise
 */
int cloud_report_fence(const uint8_t *blob, size_t len, uint32_t version, int status);

/**
 * @brief Send one telemetry report
 *
 * @param json  A JSON object from telemetry_format_json(); the adapter wraps
 *              it in whatever envelope the cloud service needs
 * @return 0 on success; a negative errno otherwise
 */
int cloud_send_telemetry(const char *json);

/**
 * @brief True once after the adapter switched the whole radio off
 *
 * First-time provisioning powers the radio off, which also stops the GNSS
 * session. The application restarts the GNSS when this returns true. Safe to
 * call from any thread; it clears the flag.
 */
bool cloud_radio_was_reset(void);

/**
 * @brief Read the current radio information
 * @return 0 on success; a negative errno if it is not available
 */
int cloud_link_info(cloud_link_info_t *info);

#ifdef __cplusplus
}
#endif

#endif /* CLOUD_H */
```

## include/cloud_sync.h
```c
/**
 * @file cloud_sync.h
 * @brief Cloud worker thread and its queues to the application
 *
 * The application thread never blocks on the network. This module owns one
 * thread that keeps the cloud link up, polls for a new fence, and sends
 * what the application posts. All the exchange goes through message queues:
 *
 *   cloud -> app: a downloaded fence blob  (cloud_sync_get_fence)
 *   app -> cloud: the result of applying it (cloud_sync_post_report)
 *                 a telemetry report         (cloud_sync_post_telemetry)
 *
 * Without CONFIG_DRVF_CLOUD every function is an inline stub, so the
 * application code has no #ifdef and the offline proof of concept builds as
 * before.
 */

#ifndef CLOUD_SYNC_H
#define CLOUD_SYNC_H

#include <errno.h>
#include <stdbool.h>
#include <stddef.h>
#include <stdint.h>

#include "telemetry.h"

#ifdef __cplusplus
extern "C" {
#endif

#ifdef CONFIG_DRVF_CLOUD

/**
 * @brief Start the cloud worker thread
 * @return 0 on success; a negative errno if the thread could not start
 */
int cloud_sync_start(void);

/**
 * @brief Take a downloaded fence blob, without waiting
 * @return 0 and the blob in @p blob (length in @p len); -EAGAIN if none
 *         arrived; -EMSGSIZE if @p cap is too small
 */
int cloud_sync_get_fence(uint8_t *blob, size_t cap, size_t *len);

/**
 * @brief Tell the cloud what happened to a downloaded fence
 *
 * Queued, never blocks. @p blob is copied.
 *
 * @return 0 if queued; -ENOSPC if the queue is full (the fence is downloaded
 *         again at the next poll); -EMSGSIZE if @p len is too large
 */
int cloud_sync_post_report(const uint8_t *blob, size_t len, uint32_t version, int status);

/**
 * @brief True once after the radio was switched off and the GNSS must restart
 *
 * First-time provisioning stops the GNSS session; see cloud_radio_was_reset().
 */
bool cloud_sync_radio_was_reset(void);

/**
 * @brief Queue a telemetry report; the worker adds the radio information
 * @return 0 if queued; -ENOSPC if the queue is full (the report is dropped)
 */
int cloud_sync_post_telemetry(const telemetry_t *report);

#else /* !CONFIG_DRVF_CLOUD */

static inline int cloud_sync_start(void)
{
	return 0;
}

static inline int cloud_sync_get_fence(uint8_t *blob, size_t cap, size_t *len)
{
	(void)blob;
	(void)cap;
	(void)len;
	return -EAGAIN;
}

static inline int cloud_sync_post_report(const uint8_t *blob, size_t len, uint32_t version,
					 int status)
{
	(void)blob;
	(void)len;
	(void)version;
	(void)status;
	return 0;
}

static inline bool cloud_sync_radio_was_reset(void)
{
	return false;
}

static inline int cloud_sync_post_telemetry(const telemetry_t *report)
{
	(void)report;
	return 0;
}

#endif /* CONFIG_DRVF_CLOUD */

#ifdef __cplusplus
}
#endif

#endif /* CLOUD_SYNC_H */
```

## include/demo_route.h
```c
/**
 * @file demo_route.h
 * @brief Simulated walk used by the demo mode
 *
 * Pure C, no hardware dependency. The walk starts at the fence center, goes
 * north in 2 m steps until it is 40 m from the center (10 m beyond the edge
 * of a 60 m square fence), and comes back. It repeats forever, so the LED
 * shows the full sequence: green, toward red, blinking red outside, and back.
 */

#ifndef DEMO_ROUTE_H
#define DEMO_ROUTE_H

#include "geofence.h"

#ifdef __cplusplus
extern "C" {
#endif

/**
 * Fictitious point used by the demo and the benchmark, so neither depends on
 * the real position of the board (a plaza in Bogota)
 */
#define DEMO_CENTER_LAT 4.6097
#define DEMO_CENTER_LON (-74.0817)

/** Steps in one full round trip; the route repeats after this many steps */
#define DEMO_ROUTE_STEPS 40

/**
 * @brief Position of the simulated walker at a given step
 *
 * @param center  Point where the walk starts and ends (the fence center)
 * @param step    Step number; any value, the route repeats every
 *                DEMO_ROUTE_STEPS steps
 * @param out     Receives the position
 * @return 0 on success, -1 if @p center or @p out is NULL
 */
int demo_route_point(const geopoint_t *center, unsigned int step, geopoint_t *out);

#ifdef __cplusplus
}
#endif

#endif /* DEMO_ROUTE_H */
```

## include/fence_codec.h
```c
/**
 * @file fence_codec.h
 * @brief Wire format and validation of a geofence polygon sent to the collar
 *
 * Pure C, no hardware dependency. The same blob travels over every link
 * (cloud, BLE, serial), so the application code does not depend on the board.
 *
 * Blob layout, all integers little endian:
 *
 *   offset  size  field
 *        0     1  version (1)
 *        1     1  flags (0, reserved)
 *        2     2  number of vertices n
 *        4     4  fence id
 *        8     4  fence version (a newer fence has a larger number)
 *       12     4  first vertex latitude, int32, 1e-7 degrees
 *       16     4  first vertex longitude, int32, 1e-7 degrees
 *       20  4*(n-1)  each next vertex: int16 latitude delta, int16 longitude
 *                    delta, in units of FENCE_CODEC_DELTA_UNIT (1e-6 degrees)
 *     20+4*(n-1)  4  CRC-32 (IEEE 802.3) of every byte before it
 *
 * A delta is computed from the previous decoded vertex, so rounding errors do
 * not add up: each vertex is within 5.5 cm of the requested one. An edge can
 * be at most 3.6 km long in latitude or longitude. The first vertex is not
 * repeated at the end.
 *
 * A fence is accepted only if it is a simple polygon (no edge crosses or
 * touches another), has between 3 and FENCE_CODEC_MAX_VERTICES vertices,
 * lies within 85 degrees of latitude and inside -180..180 degrees of
 * longitude (the geofence engine does not support the antimeridian) and
 * covers at least FENCE_CODEC_MIN_AREA_M2.
 */

#ifndef FENCE_CODEC_H
#define FENCE_CODEC_H

#include <stddef.h>
#include <stdint.h>

#include "geofence.h"

#ifdef __cplusplus
extern "C" {
#endif

#define FENCE_CODEC_VERSION 1

/** Maximum number of vertices; override with -DFENCE_CODEC_MAX_VERTICES=n */
#ifndef FENCE_CODEC_MAX_VERTICES
#define FENCE_CODEC_MAX_VERTICES 128
#endif

#if FENCE_CODEC_MAX_VERTICES > 256
/* The area and crossing tests use int64 sums that are proven for up to 256 vertices. */
#error "FENCE_CODEC_MAX_VERTICES must not exceed 256"
#endif

/** Minimum number of vertices of a polygon */
#define FENCE_CODEC_MIN_VERTICES 3

/** Delta unit, in 1e-7 degrees (1e-6 degrees, about 11 cm) */
#define FENCE_CODEC_DELTA_UNIT 10

/** Smallest accepted area, in square meters (GNSS accuracy is about 2.5 m) */
#define FENCE_CODEC_MIN_AREA_M2 100.0

/** Size of a blob with the smallest valid vertex count */
#define FENCE_CODEC_MIN_SIZE 32

/** Size of a blob with the largest valid vertex count */
#define FENCE_CODEC_MAX_SIZE (20 + 4 * FENCE_CODEC_MAX_VERTICES)

/** Result codes. Zero is success; the rest are negative. */
enum fence_codec_status {
	FENCE_CODEC_OK = 0,
	FENCE_CODEC_ERR_ARG = -1,          /**< NULL argument or bad capacity */
	FENCE_CODEC_ERR_SIZE = -2,         /**< length does not match the header */
	FENCE_CODEC_ERR_CRC = -3,          /**< checksum mismatch */
	FENCE_CODEC_ERR_FORMAT = -4,       /**< unknown version or flags */
	FENCE_CODEC_ERR_VERTEX_COUNT = -5, /**< fewer than 3 or too many vertices */
	FENCE_CODEC_ERR_RANGE = -6,        /**< coordinate out of range */
	FENCE_CODEC_ERR_NOT_SIMPLE = -7,   /**< edges cross, touch or overlap */
	FENCE_CODEC_ERR_AREA = -8,         /**< area below the minimum */
	FENCE_CODEC_ERR_EDGE_TOO_LONG = -9, /**< encode: edge over 3.6 km */
	FENCE_CODEC_ERR_BUFFER = -10       /**< output buffer too small */
};

/** Fence identity carried in the blob header */
typedef struct {
	uint32_t fence_id;      /**< Identifier chosen by the sender */
	uint32_t fence_version; /**< Larger means newer */
	uint16_t num_vertices;  /**< Number of vertices (decode output) */
} fence_codec_header_t;

/**
 * @brief CRC-32 (IEEE 802.3, the zlib one) of a buffer
 */
uint32_t fence_codec_crc32(const uint8_t *data, size_t len);

/**
 * @brief Size in bytes of the blob that holds n vertices
 */
size_t fence_codec_encoded_size(uint16_t n);

/**
 * @brief Encode a polygon into a blob
 *
 * Applies the same checks as fence_codec_decode() to the vertices as they
 * will be decoded, so a blob that encodes always decodes. The header's
 * num_vertices field is ignored: @p n is used.
 *
 * @param header    Fence id and version
 * @param vertices  Polygon vertices, first vertex not repeated
 * @param n         Number of vertices
 * @param buf       Receives the blob
 * @param buf_len   Capacity of @p buf
 * @param out_len   Receives the blob size on success
 * @return FENCE_CODEC_OK or a negative fence_codec_status
 */
int fence_codec_encode(const fence_codec_header_t *header,
		       const geopoint_t *vertices, uint16_t n,
		       uint8_t *buf, size_t buf_len, size_t *out_len);

/**
 * @brief Decode and validate a blob
 *
 * Checks, in this order: length, version and flags, vertex count, exact
 * length, CRC, coordinate ranges, simple polygon, minimum area. Nothing is
 * written to @p out unless every check passes.
 *
 * @param buf      The blob
 * @param len      Its length
 * @param out      Receives the vertices
 * @param out_cap  Capacity of @p out, in vertices
 * @param header   Receives the fence id, version and vertex count
 * @return FENCE_CODEC_OK or a negative fence_codec_status
 */
int fence_codec_decode(const uint8_t *buf, size_t len,
		       geopoint_t *out, size_t out_cap,
		       fence_codec_header_t *header);

#ifdef __cplusplus
}
#endif

#endif /* FENCE_CODEC_H */
```

## include/fence_manager.h
```c
/**
 * @file fence_manager.h
 * @brief Owner of the active fence: load, replace, persist
 *
 * Pure C, no hardware dependency. The manager is the only writer of the
 * geofence engine's polygon (the engine has no lock, see geofence.h), so it
 * must be used from one thread, the one that also checks fixes against the
 * fence. A new fence goes through these steps, and any failure leaves the
 * current fence and the stored one untouched:
 *
 *   decode and validate (fence_codec) -> build the polygon ->
 *   save to the store -> replace the current polygon
 *
 * The sender's state wins: any valid fence replaces the current one, whatever
 * its version, so a wrong clock or a fence with a huge version cannot block
 * later updates. The id and version only identify a fence: the same id,
 * version and content again is a repeated download and changes nothing.
 * Version 0 is reserved for fences the device made itself (the square around
 * the first fix, the demo fence). A portal should use the time in seconds as
 * the version, so versions grow and are easy to read.
 */

#ifndef FENCE_MANAGER_H
#define FENCE_MANAGER_H

#include <stdbool.h>
#include <stddef.h>
#include <stdint.h>

#include "fence_codec.h"
#include "fence_store.h"
#include "geofence.h"

#ifdef __cplusplus
extern "C" {
#endif

/** Manager results; fence_codec_status values (-1 to -10) pass through. */
enum fence_manager_status {
	FENCE_MANAGER_OK = 0,
	FENCE_MANAGER_NOTHING_STORED = 1,      /**< load: the store is empty */
	FENCE_MANAGER_ALREADY_ACTIVE = 2,      /**< apply: this exact fence is active */
	FENCE_MANAGER_ERR_VERSION = -21,       /**< version 0 is reserved */
	FENCE_MANAGER_ERR_STORE = -22,         /**< the store could not save or load */
	FENCE_MANAGER_ERR_ENGINE = -23,        /**< the geofence engine refused it */
	FENCE_MANAGER_ERR_ARG = -24            /**< NULL argument */
};

/**
 * The fields are private: use the functions below, so a later format with
 * several polygons stays inside this module.
 */
typedef struct {
	geofence_t fence;
	bool has_fence;
	uint32_t fence_id;
	uint32_t fence_version; /* 0 for a fence made by the device */
	uint32_t blob_crc;      /* CRC-32 of the active blob, to spot a repeated download */
	const fence_store_ops_t *store; /* NULL: do not persist */

	/* Work buffers, kept here so the calls do not use the caller's stack. */
	geopoint_t scratch_vertices[FENCE_CODEC_MAX_VERTICES];
	uint8_t scratch_blob[FENCE_CODEC_MAX_SIZE];
} fence_manager_t;

/**
 * @brief Start a manager with no fence
 * @param store  Where to persist fences, or NULL to keep them in memory only
 */
void fence_manager_init(fence_manager_t *manager, const fence_store_ops_t *store);

/**
 * @brief Load the stored fence, replacing the current one
 *
 * A stored fence that no longer validates is ignored and reported, never
 * used. The current fence is released only if a stored one is accepted.
 *
 * @return FENCE_MANAGER_OK if a stored fence is now active;
 *         FENCE_MANAGER_NOTHING_STORED if the store is empty (current fence
 *         unchanged); a negative status if the stored blob is invalid or the
 *         store failed (current fence unchanged)
 */
int fence_manager_load(fence_manager_t *manager);

/**
 * @brief Validate, persist and activate a fence blob received from outside
 *
 * @return FENCE_MANAGER_OK if the fence is now active and stored;
 *         FENCE_MANAGER_ALREADY_ACTIVE if this exact fence (same id, version
 *         and content) is already active (a repeated download; nothing
 *         changes and it counts as success); otherwise a negative fence_codec_status or
 *         fence_manager_status. On any error the current fence and the
 *         stored one are unchanged.
 */
int fence_manager_apply(fence_manager_t *manager, const uint8_t *blob, size_t len);

/**
 * @brief Use a fence made by the device, without storing it
 *
 * Its version is 0, so any fence from outside replaces it. The current fence
 * is released only if the new one is built.
 *
 * @return FENCE_MANAGER_OK, FENCE_MANAGER_ERR_ARG or FENCE_MANAGER_ERR_ENGINE
 */
int fence_manager_use_transient(fence_manager_t *manager, const geopoint_t *vertices,
				uint16_t n);

/**
 * @brief Drop the current fence; the stored one is kept
 */
void fence_manager_release(fence_manager_t *manager);

/**
 * @brief True if there is an active fence
 */
bool fence_manager_has_fence(const fence_manager_t *manager);

/**
 * @brief Identity of the active fence
 * @param info  Receives the fence id, version and number of vertices
 * @return true if there is an active fence; false (and @p info untouched) if not
 */
bool fence_manager_info(const fence_manager_t *manager, fence_codec_header_t *info);

/**
 * @brief Check a point against the active fence
 *
 * Same results as geofence_check(); GEOFENCE_ERROR_EMPTY_POLYGON if there is
 * no active fence.
 */
int fence_manager_check(const fence_manager_t *manager, const geopoint_t *point,
			geofence_result_t *result);

#ifdef __cplusplus
}
#endif

#endif /* FENCE_MANAGER_H */
```

## include/fence_square.h
```c
/**
 * @file fence_square.h
 * @brief Square geofence polygon centered on a point
 *
 * Pure C, no hardware dependency. Used by the proof of concept to fence the
 * place where the first GNSS fix was obtained.
 */

#ifndef FENCE_SQUARE_H
#define FENCE_SQUARE_H

#include "geofence.h"

#ifdef __cplusplus
extern "C" {
#endif

#define FENCE_SQUARE_VERTICES 4

/**
 * @brief Compute the corners of a square centered on a point
 *
 * The square's sides run north-south and east-west, each @p half_side_m
 * meters from the center. Vertices are ordered southwest, southeast,
 * northeast, northwest, and the first vertex is not repeated.
 *
 * @param center       Center of the square
 * @param half_side_m  Distance from the center to each side, in meters (> 0)
 * @param out          Receives the four corners
 * @return 0 on success; -1 if an argument is NULL, the center is NaN or out
 *         of range, half_side_m is not a positive finite number, the center
 *         is beyond 85 degrees of latitude (where the geofence distance is
 *         no longer accurate) or the square would cross the antimeridian
 */
int fence_square_vertices(const geopoint_t *center, double half_side_m,
			  geopoint_t out[FENCE_SQUARE_VERTICES]);

#ifdef __cplusplus
}
#endif

#endif /* FENCE_SQUARE_H */
```

## include/fence_store.h
```c
/**
 * @file fence_store.h
 * @brief Fence storage port: keep one fence blob across reboots
 *
 * The fence manager calls these functions through a table, so it is tested on
 * the host with an in-memory store and runs on the board with the Zephyr
 * settings store (fence_store_settings.c). The blob is stored exactly as it
 * arrived (see fence_codec.h) and is validated again every time it is loaded.
 */

#ifndef FENCE_STORE_H
#define FENCE_STORE_H

#include <stddef.h>
#include <stdint.h>

#ifdef __cplusplus
extern "C" {
#endif

typedef struct {
	/**
	 * Read the stored blob.
	 * @return 0 and the length in @p len; -ENOENT if nothing is stored;
	 *         another negative errno on a storage error
	 */
	int (*load)(void *ctx, uint8_t *blob, size_t cap, size_t *len);

	/**
	 * Replace the stored blob. The old blob must stay intact if this fails
	 * or power is lost halfway.
	 * @return 0 on success; a negative errno otherwise
	 */
	int (*save)(void *ctx, const uint8_t *blob, size_t len);

	void *ctx; /**< Passed back to every call */
} fence_store_ops_t;

/**
 * @brief Store backed by the Zephyr settings subsystem (Zephyr builds only)
 *
 * Initializes the settings subsystem on first use.
 *
 * @return The store table, or NULL if the settings subsystem failed to start
 */
const fence_store_ops_t *fence_store_settings(void);

#ifdef __cplusplus
}
#endif

#endif /* FENCE_STORE_H */
```
